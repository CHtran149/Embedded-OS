## BTL/BTL/Config.in
```kconfig
config BR2_PACKAGE_BTL
	bool "btl-power-monitor"
	depends on BR2_TOOLCHAIN_HAS_THREADS
	help
	  Ứng dụng giám sát điện năng sử dụng PZEM-004T (UART1) 
	  và hiển thị lên OLED SSD1306 (I2C2).
	  Yêu cầu Driver pzem_driver và ssd1306_driver.

comment "BTL app needs a toolchain w/ threads"
	depends on !BR2_TOOLCHAIN_HAS_THREADS
```

## BTL/button-input/Config.in
```kconfig
config BR2_PACKAGE_BUTTON_INPUT
	bool "button-input"
	depends on BR2_LINUX_KERNEL
	help
	  Kernel module for button using Input Subsystem on BBB.
```

## BTL/led-driver/Config.in
```kconfig
config BR2_PACKAGE_LED_DRIVER
	bool "led-driver"
	depends on BR2_LINUX_KERNEL
	help
	  Driver dieu khien LED tren BeagleBone Black.
	  Driver nay cho phep dieu khien LED qua file /dev/led_test.
```

## BTL/pzem_driver/Config.in
```kconfig
config BR2_PACKAGE_PZEM_DRIVER
	bool "pzem_driver"
	depends on BR2_LINUX_KERNEL
	help
	  Kernel Driver cho PZEM-004T su dung Serdev (BTL).
```

## BTL/ssd1306_driver/Config.in
```kconfig
config BR2_PACKAGE_SSD1306_DRIVER
	bool "ssd1306_driver"
	depends on BR2_LINUX_KERNEL
	help
	  Linux Kernel Module for SSD1306 OLED Display via I2C.
```
